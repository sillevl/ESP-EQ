## main/Kconfig.projbuild
```kconfig
menu "ESP-DSP Audio Configuration"

    config AUDIO_SAMPLE_RATE
        int "Audio Sample Rate (Hz)"
        default 48000
        help
            Sample rate for audio processing.
            Common values: 44100, 48000, 96000, 192000
            
    config AUDIO_BUFFER_SIZE
        int "DMA Buffer Size (samples)"
        default 1024
        help
            Size of each DMA buffer in samples.
            Larger buffers = more latency but more stable.
            Smaller buffers = less latency but may cause underruns.

endmenu
```

## sdkconfig.defaults
```kconfig
# ESP32 Audio DSP Configuration

# Increase main task stack size
CONFIG_ESP_MAIN_TASK_STACK_SIZE=8192

# FreeRTOS Configuration
CONFIG_FREERTOS_HZ=1000

# ESP32 specific
CONFIG_ESP32_DEFAULT_CPU_FREQ_240=y

# Component config
CONFIG_LOG_DEFAULT_LEVEL_INFO=y

# I2S Configuration
# Enable I2S
CONFIG_ESP32_I2S_ENABLE=y
```
